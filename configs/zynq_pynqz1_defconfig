## configs/zynq_pynqz1_defconfig
```kconfig
CONFIG_ARM=y
CONFIG_ARCH_ZYNQ=y
CONFIG_TARGET_ZYNQ_PYNQZ1=y
CONFIG_DEFAULT_DEVICE_TREE="zynq-pynqz1"
CONFIG_SPL=y
CONFIG_FIT=y
CONFIG_FIT_VERBOSE=y
CONFIG_FIT_SIGNATURE=y
CONFIG_SYS_PROMPT="Blue> "
# CONFIG_CMD_IMLS is not set
# CONFIG_CMD_FLASH is not set
CONFIG_CMD_MMC=y
CONFIG_CMD_GPIO=y
# CONFIG_CMD_SETEXPR is not set
CONFIG_CMD_MII=y
CONFIG_CMD_CACHE=y
CONFIG_CMD_EXT2=y
CONFIG_CMD_EXT4=y
CONFIG_CMD_EXT4_WRITE=y
CONFIG_CMD_FAT=y
CONFIG_CMD_FS_GENERIC=y
CONFIG_NET_RANDOM_ETHADDR=y
CONFIG_SPL_DM_SEQ_ALIAS=y
CONFIG_ZYNQ_SDHCI=y
CONFIG_SPI_FLASH=y
CONFIG_SPI_FLASH_BAR=y
CONFIG_SPI_FLASH_SPANSION=y
CONFIG_ZYNQ_GEM=y
CONFIG_DEBUG_UART=y
CONFIG_DEBUG_UART_ZYNQ=y
CONFIG_DEBUG_UART_BASE=0xe0000000
CONFIG_DEBUG_UART_CLOCK=50000000
CONFIG_ZYNQ_QSPI=y
CONFIG_USB=y
CONFIG_USB_ULPI_VIEWPORT=y
CONFIG_USB_ULPI=y
CONFIG_USB_GADGET=y
CONFIG_CI_UDC=y
CONFIG_USB_GADGET_DOWNLOAD=y
CONFIG_G_DNL_MANUFACTURER="Xilinx"
CONFIG_G_DNL_VENDOR_NUM=0x03fd
CONFIG_G_DNL_PRODUCT_NUM=0x0300
CONFIG_OF_EMBED=y
CONFIG_MENU=y
CONFIG_MENU_SHOW=y
CONFIG_CMD_BOOTMENU=y

# CONFIGE_USE_BOOTARGS=y
# CONFIG_USE_BOOTCOMMAND=y
# CONFIG_BOOTARGS="console=ttyPS0,115200n8 root=/dev/mmcblk0p2 rw rootfstype=ext4"
# CONFIG_BOOTCOMMAND="fatload mmc 0:1 0x08020000 uImage;fatload mmc 0:1 0x25d84300 zynq-pynqz1.dtb; bootm 0x08020000 - 0x25d84300"
# CONFIG_BOOTDELAY=4
# CONFIG_BOOTSTAGE=y
# CONFIG_BOOTSTAGE_REPORT=y
# CONFIG_CMD_BOOTSTAGE=y
# CONFIG_CMD_BOOTM=y
# CONFIG_AUTOBOOT_KEYED=y
# CONFIG_AUTOBOOT_STOP_STR="Stoppinig autoboot"
# CONFIG_AUTOBOOT_PROMPT="autoboot in %d seconds\n"
# CONFIG_DEBUG=y
# CONFIG_SYS_TEXT_BASE=0x8000000
# CONFIG_OF_CONTROL=y
# CONFIG_CMD_RUN=y
# CONFIG_PREBOOT="run bootcmd"
```
